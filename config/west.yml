## config/west.yml
```yaml
manifest:
  remotes:
    - name: mkopec
      url-base: https://github.com/mkopec
  projects:
    - name: zmk
      remote: mkopec
      revision: main
      import: app/west.yml
  self:
    path: config
```
